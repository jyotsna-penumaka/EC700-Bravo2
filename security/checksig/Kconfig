## security/checksig/Kconfig
```kconfig
config SECURITY_CHECK_SIG
	bool "Signature-Checking Security Module"
	depends on SECURITY
	depends on NET
	select SECURITYFS
	select SECURITY_PATH
	select SECURITY_NETWORK
	select SRCU
	select BUILD_BIN2C
	default n
	help
	  This enables attribute-based access control.
          Binaries will only be permitted to be executed
          if there is a matching name in the
          extended attribute.
```
